/* Copyright (c) 2013, The Linux Foundation. All rights reserved.
 *
 * This program is free software; you can redistribute it and/or modify
 * it under the terms of the GNU General Public License version 2 and
 * only version 2 as published by the Free Software Foundation.
 *
 * This program is distributed in the hope that it will be useful,
 * but WITHOUT ANY WARRANTY; without even the implied warranty of
 * MERCHANTABILITY or FITNESS FOR A PARTICULAR PURPOSE.  See the
 * GNU General Public License for more details.
 */


&mdss_mdp {
	dsi_lead_hx8379c_boe_4p0_wvga_vid: qcom,mdss_dsi_hx8379c_boe_4p0_wvga_video {
		qcom,mdss-dsi-panel-name = "zteLEAD(HX8379C)BOE_480*800_4Inch";
		qcom,mdss-pan-physical-height-dimension = <86>;		
		qcom,mdss-pan-physical-width-dimension = <52>;		
		qcom,cont-splash-enabled;
		qcom,mdss-dsi-panel-controller = <&mdss_dsi0>;
		qcom,mdss-dsi-panel-type = "dsi_video_mode";
		qcom,mdss-dsi-panel-destination = "display_1";	
		qcom,mdss-dsi-panel-framerate = <60>;
		qcom,mdss-dsi-virtual-channel-id = <0>;
		qcom,mdss-dsi-stream = <0>;
		qcom,mdss-dsi-panel-width = <480>;
		qcom,mdss-dsi-panel-height = <800>;
		qcom,mdss-dsi-h-front-porch = <54>;
		qcom,mdss-dsi-h-back-porch = <54>;
		qcom,mdss-dsi-h-pulse-width = <54>;
		qcom,mdss-dsi-h-sync-skew = <0>;
		qcom,mdss-dsi-v-front-porch = <6>;
		qcom,mdss-dsi-v-back-porch = <5>;
		qcom,mdss-dsi-v-pulse-width = <6>;
		qcom,mdss-dsi-h-left-border = <0>;
		qcom,mdss-dsi-h-right-border = <0>;
		qcom,mdss-dsi-v-top-border = <0>;
		qcom,mdss-dsi-v-bottom-border = <0>;
		qcom,mdss-dsi-bpp = <24>;
		qcom,mdss-dsi-color-order = "rgb_swap_rgb";
		qcom,mdss-dsi-underflow-color = <0xff>;
		qcom,mdss-dsi-border-color = <0>;
		qcom,mdss-dsi-on-command = [
		39 00 00 00 00 00 04 B9 FF 83 79
		39 00 00 00 00 00 15 B1 C4 18 18 31 51 50 D0 F2 E6 80 38 38 F8 22 22 22 00 80 30 00
		39 00 00 00 00 00 0A B2 80 3C 0B 04 00 50 11 42 15
		39 00 00 00 00 00 0B B4 50 60 50 60 50 60 02 82 03 82
		39 00 00 00 00 00 02 CC 02
		39 00 00 00 00 00 02 D2 33
		39 00 00 00 00 00 1E D3 00 07 00 00 00 0E 0E 32 10 04 00 04 03 6F 03 6F 00 07 00 07 21 22 05 05 23 05 05 23 09
		39 00 00 00 00 00 21 D5 18 18 19 19 01 00 03 02 21 20 18 18 18 18 18 18 18 18 18 18 18 18 18 18 18 18 18 18 18 18 18 18
		39 00 00 00 00 00 21 D6 18 18 18 18 02 03 00 01 20 21 19 19 18 18 18 18 18 18 18 18 18 18 18 18 18 18 18 18 18 18 18 18
		39 00 00 00 00 00 2B E0 00 0D 1A 17 17 3F 33 3D 0A 0F 10 1A 10 15 17 15 15 08 13 14 18 00 0E 1B 17 17 3F 32 3D 0A 0F 10 1A 10 15 17 15 15 08 13 14 18
		39 00 00 00 00 00 03 B6 96 96
		39 00 00 00 00 00 05 C7 00 00 00 C0
		39 00 00 00 00 00 04 C9 1F 00 0A
		05 01 00 00 78 00 02 11 00
		39 00 00 00 00 00 0A BA 41 83 A8 4D B2 24 00 00 50 
		05 01 00 00 05 00 02 29 00
		];
		qcom,mdss-dsi-off-command = [
		05 01 00 00 0a 00 02 28 00
		05 01 00 00 78 00 02 10 00];
		qcom,mdss-dsi-on-command-state = "dsi_lp_mode";
		qcom,mdss-dsi-off-command-state = "dsi_hs_mode";
		qcom,mdss-dsi-h-sync-pulse = <1>;
		qcom,mdss-dsi-traffic-mode = "burst_mode";
		qcom,mdss-dsi-lane-map = "lane_map_0123";
		qcom,mdss-dsi-bllp-eof-power-mode;
		qcom,mdss-dsi-bllp-power-mode;
		qcom,suspend-ulps-enabled;
		qcom,mdss-dsi-lane-0-state;
		qcom,mdss-dsi-lane-1-state;
		qcom,mdss-dsi-panel-timings = [75 18 10 00 3A 3C 14 1C 13 03 04 00];
		qcom,mdss-dsi-t-clk-post = <0x04>;
		qcom,mdss-dsi-t-clk-pre = <0x19>;
		qcom,mdss-dsi-bl-min-level = <1>;
		qcom,mdss-dsi-bl-max-level = <255>;
		qcom,mdss-dsi-dma-trigger = "trigger_sw";
		qcom,mdss-dsi-mdp-trigger = "none";			
		qcom,mdss-dsi-bl-pmic-control-type = "bl_ctrl_dcs";
		qcom,mdss-dsi-reset-sequence = <1 5>, <0 5>, <1 20>;	
		qcom,mdss-dsi-lp11-init;
		qcom,mdss-dsi-init-delay-us = <7000>;
	};
};
