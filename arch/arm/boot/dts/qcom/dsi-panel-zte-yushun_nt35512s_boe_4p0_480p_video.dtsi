/* Copyright (c) 2013, The Linux Foundation. All rights reserved.
 *
 * This program is free software; you can redistribute it and/or modify
 * it under the terms of the GNU General Public License version 2 and
 * only version 2 as published by the Free Software Foundation.
 *
 * This program is distributed in the hope that it will be useful,
 * but WITHOUT ANY WARRANTY; without even the implied warranty of
 * MERCHANTABILITY or FITNESS FOR A PARTICULAR PURPOSE.  See the
 * GNU General Public License for more details.
 */


&mdss_mdp {
	dsi_yushun_nt35512s_boe_4p0_wvga_vid: qcom,mdss_dsi_yushun_nt35512s_boe_4p0_wvga_video {
		qcom,mdss-dsi-panel-name = "zteYUSHUN(NT35512S)BOE_480*800_4Inch";
		qcom,mdss-pan-physical-height-dimension = <86>;		
		qcom,mdss-pan-physical-width-dimension = <52>;		
		qcom,cont-splash-enabled;
		qcom,mdss-dsi-panel-controller = <&mdss_dsi0>;
		qcom,mdss-dsi-panel-type = "dsi_video_mode";
		qcom,mdss-dsi-panel-destination = "display_1";	
		qcom,mdss-dsi-panel-framerate = <60>;
		qcom,mdss-dsi-virtual-channel-id = <0>;
		qcom,mdss-dsi-stream = <0>;
		qcom,mdss-dsi-panel-width = <480>;
		qcom,mdss-dsi-panel-height = <800>;
		qcom,mdss-dsi-h-front-porch = <60>;
		qcom,mdss-dsi-h-back-porch = <60>;
		qcom,mdss-dsi-h-pulse-width = <20>;
		qcom,mdss-dsi-h-sync-skew = <0>;
		qcom,mdss-dsi-v-front-porch = <15>;
		qcom,mdss-dsi-v-back-porch = <16>;
		qcom,mdss-dsi-v-pulse-width = <2>;
		qcom,mdss-dsi-h-left-border = <0>;
		qcom,mdss-dsi-h-right-border = <0>;
		qcom,mdss-dsi-v-top-border = <0>;
		qcom,mdss-dsi-v-bottom-border = <0>;
		qcom,mdss-dsi-bpp = <24>;
		qcom,mdss-dsi-color-order = "rgb_swap_rgb";
		qcom,mdss-dsi-underflow-color = <0xff>;
		qcom,mdss-dsi-border-color = <0>;
		qcom,mdss-dsi-on-command = [
39 00 00 00 00 00 05 FF AA 55 A5 80
39 00 00 00 00 00 02 6F 0E
39 00 00 00 00 00 02 F4 1A
39 01 00 00 00 00 02 6F 02
39 01 00 00 00 00 02 F2 28
39 01 00 00 00 00 02 6F 0c
39 01 00 00 00 00 02 FE 18
39 00 00 00 00 00 05 FF AA 55 A5 00
39 00 00 00 00 00 06 F0 55 AA 52 08 01
39 00 00 00 00 00 04 B0 0A 0A 0A
39 00 00 00 00 00 04 B6 34 34 34
39 00 00 00 00 00 04 B1 0A 0A 0A
39 00 00 00 00 00 04 B7 24 24 24
39 00 00 00 00 00 04 B3 08 08 08
39 00 00 00 00 00 04 B9 34 34 34
39 00 00 00 00 00 04 B5 0A 0A 0A
39 00 00 00 00 00 04 BA 24 24 24
39 00 00 00 00 00 04 BC 00 50 00
39 00 00 00 00 00 04 BD 00 50 00
39 00 00 00 00 00 35 D1 00 00 00 1C 00 5F 00 70 00 8E 00 BA 00 EA 01 16 01 3F 01 7B 01 A5 01 DE 02 13 02 14 02 3F 02 69 02 80 02 9A 02 AD 02 C5 02 D4 02 E5 02 F6 03 09 0339 03 FF
39 00 00 00 00 00 35 D2 00 00 00 1C 00 5F 00 70 00 8E 00 BA 00 EA 01 16 01 3F 01 7B 01 A5 01 DE 02 13 02 14 02 3F 02 69 02 80 02 9A 02 AD 02 C5 02 D4 02 E5 02 F6 03 09 0339 03 FF
39 00 00 00 00 00 35 D3 00 00 00 1C 00 5F 00 70 00 8E 00 BA 00 EA 01 16 01 3F 01 7B 01 A5 01 DE 02 13 02 14 02 3F 02 69 02 80 02 9A 02 AD 02 C5 02 D4 02 E5 02 F6 03 09 0339 03 FF
39 00 00 00 00 00 35 D4 00 00 00 1C 00 5F 00 70 00 8E 00 BA 00 EA 01 16 01 3F 01 7B 01 A5 01 DE 02 13 02 14 02 3F 02 69 02 80 02 9A 02 AD 02 C5 02 D4 02 E5 02 F6 03 09 0339 03 FF
39 00 00 00 00 00 35 D5 00 00 00 1C 00 5F 00 70 00 8E 00 BA 00 EA 01 16 01 3F 01 7B 01 A5 01 DE 02 13 02 14 02 3F 02 69 02 80 02 9A 02 AD 02 C5 02 D4 02 E5 02 F6 03 09 0339 03 FF
39 00 00 00 00 00 35 D6 00 00 00 1C 00 5F 00 70 00 8E 00 BA 00 EA 01 16 01 3F 01 7B 01 A5 01 DE 02 13 02 14 02 3F 02 69 02 80 02 9A 02 AD 02 C5 02 D4 02 E5 02 F6 03 09 0339 03 FF
39 00 00 00 00 00 35 D1 00 00 00 02 00 10 00 24 00 40 00 77 00 A6 00 EE 01 1F 01 61 01 92 01 DA 02 0D 02 0E 02 38 02 63 02 7D 02 9B 02 AE 02 C6 02 D5 02 EA 02 F9 03 11 03 4B 03 FF
39 00 00 00 00 00 35 D2 00 00 00 02 00 10 00 24 00 40 00 77 00 A6 00 EE 01 1F 01 61 01 92 01 DA 02 0D 02 0E 02 38 02 63 02 7D 02 9B 02 AE 02 C6 02 D5 02 EA 02 F9 03 11 03 4B 03 FF
39 00 00 00 00 00 35 D3 00 00 00 02 00 10 00 24 00 40 00 77 00 A6 00 EE 01 1F 01 61 01 92 01 DA 02 0D 02 0E 02 38 02 63 02 7D 02 9B 02 AE 02 C6 02 D5 02 EA 02 F9 03 11 03 4B 03 FF
39 00 00 00 00 00 35 D4 00 00 00 02 00 10 00 24 00 40 00 77 00 A6 00 EE 01 1F 01 61 01 92 01 DA 02 0D 02 0E 02 38 02 63 02 7D 02 9B 02 AE 02 C6 02 D5 02 EA 02 F9 03 11 03 4B 03 FF
39 00 00 00 00 00 35 D5 00 00 00 02 00 10 00 24 00 40 00 77 00 A6 00 EE 01 1F 01 61 01 92 01 DA 02 0D 02 0E 02 38 02 63 02 7D 02 9B 02 AE 02 C6 02 D5 02 EA 02 F9 03 11 03 4B 03 FF
39 00 00 00 00 00 35 D6 00 00 00 02 00 10 00 24 00 40 00 77 00 A6 00 EE 01 1F 01 61 01 92 01 DA 02 0D 02 0E 02 38 02 63 02 7D 02 9B 02 AE 02 C6 02 D5 02 EA 02 F9 03 11 03 4B 03 FF
39 00 00 00 00 00 06 F0 55 AA 52 08 02
39 00 00 00 00 00 02 B4 64    //PWMƵ<C2><CA>Ϊ25.5KHz
39 00 00 00 00 00 06 F0 55 AA 52 08 00
39 00 00 00 00 00 02 B6 05
39 00 00 00 00 00 03 B7 00 00
39 00 00 00 00 00 05 B8 01 05 05 05
39 00 00 00 00 00 02 BA 01
39 00 00 00 00 00 04 BC 00 00 00
39 00 00 00 00 00 04 CC 03 00 00
39 00 00 00 00 00 03 B1 FC 00
39 00 00 00 00 00 02 B5 50
39 00 00 00 00 00 03 E0 01 01
05 00 00 00 00 00 02 35 00
39 00 00 00 00 00 02 53 24
05 01 00 00 78 00 02 11 00
05 01 00 00 0a 00 02 29 00
];
		qcom,mdss-dsi-off-command = [
			05 01 00 00 0a 00 02 28 00
			05 01 00 00 78 00 02 10 00
			15 01 00 00 00 00 02 4f 01];
		qcom,mdss-dsi-on-command-state = "dsi_lp_mode";
		qcom,mdss-dsi-off-command-state = "dsi_hs_mode";
		qcom,mdss-dsi-h-sync-pulse = <1>;
		qcom,mdss-dsi-traffic-mode = "burst_mode";
		qcom,mdss-dsi-lane-map = "lane_map_0123";
		qcom,mdss-dsi-bllp-eof-power-mode;
		qcom,mdss-dsi-bllp-power-mode;
		qcom,mdss-dsi-lane-0-state;
		qcom,mdss-dsi-lane-1-state;
		qcom,mdss-dsi-panel-timings = [6d 18 10 00 3a 3e 12 1a 13 03 04 00];
		qcom,mdss-dsi-t-clk-post = <0x04>;
		qcom,mdss-dsi-t-clk-pre = <0x24>;
		qcom,mdss-dsi-bl-min-level = <1>;
		qcom,mdss-dsi-bl-max-level = <255>;
		qcom,mdss-dsi-dma-trigger = "trigger_sw";
		qcom,mdss-dsi-mdp-trigger = "none";			
		qcom,mdss-dsi-bl-pmic-control-type = "bl_ctrl_dcs";
		qcom,mdss-dsi-reset-sequence = <1 5>, <0 5>, <1 20>;	
		qcom,mdss-dsi-lp11-init;
		qcom,mdss-dsi-init-delay-us = <7000>;
	};
};
